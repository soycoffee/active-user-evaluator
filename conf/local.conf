## conf/local.conf
```bitbake
include "application.conf"

play.evolutions.db.default.autoApply=true

slick.dbs.default.profile="slick.jdbc.PostgresProfile$"
slick.dbs.default.db.driver="org.postgresql.Driver"
slick.dbs.default.db.url="jdbc:postgresql://localhost:5432/postgres"
slick.dbs.default.db.user="postgres"
slick.dbs.default.db.password="p"

apiDefinition.operationKey="local"
```
